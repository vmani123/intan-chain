## esp/main/Kconfig.projbuild
```kconfig
menu "intan-chain benchmark node"

config CHAIN_WIFI_SSID
    string "Wi-Fi SSID"
    default "intan-bench"
    help
        SSID of the access point the node streams through. Put the node and
        the host on the same AP with nothing else associated, or the number
        this firmware produces measures the neighbours as much as the node.

config CHAIN_WIFI_PASSWORD
    string "Wi-Fi password"
    default "changeme"
    help
        Empty string means an open network.

config CHAIN_WIFI_MAX_RETRY
    int "Association attempts before giving up"
    default 20
    help
        On giving up the node logs and reboots, so an unattended bench run
        recovers from an AP restart instead of sitting dark.

config CHAIN_HOST_IP
    string "Host IPv4 address for the data stream"
    default "192.168.4.2"
    help
        Datagrams go to this address on CHAIN_UDP_PORT. Unicast, not
        broadcast: broadcast frames are sent at the basic rate (1 or 6 Mbit/s)
        and would cap the measurement far below the link rate.

config CHAIN_SINK_TCP
    bool "Send over TCP instead of UDP"
    default n
    help
        Connect to CHAIN_HOST_IP on the data port over TCP and write the same
        fixed-size records back to back, instead of one UDP datagram each.
        Every datagram is copied at once into a spool in PSRAM
        (CHAIN_TCP_SPOOL_DGRAMS), so the FPGA never waits; a second task
        drains the spool into the socket and simply waits while the radio
        is behind. Late data instead of lost data: only an outage longer
        than the spool loses anything, and that is counted on the 1 Hz
        "tcp:" line. Needs CONFIG_SPIRAM and a listener on the host:
        chain.viewer --tcp. Unset (default) is the UDP sink the throughput
        numbers were taken with.

config CHAIN_TCP_SPOOL_DGRAMS
    int "TCP spool depth, datagrams (PSRAM)"
    depends on CHAIN_SINK_TCP
    default 2000
    range 16 6000
    help
        How many datagrams the TCP sink can hold while the radio is behind.
        Each is 1392 bytes and lives in PSRAM (enable CONFIG_SPIRAM). At
        2 kS/s the FPGA sends 400 datagrams/s, so 2000 rides out a 5 s
        outage with nothing lost. Without PSRAM the sink falls back to 24
        datagrams in internal RAM and says so at boot.

config CHAIN_SYNTH_SAMPLE_HZ
    int "Stage 0 synthetic sample rate, Hz per channel"
    default 20000
    range 100 60000
    help
        Offered load = SAMPLE_HZ / FRAMES_PER_DGRAM datagrams per second.
        At 20000 Hz that is 4000 x 1392 B = 5.57 MB/s = 44.6 Mbit/s of UDP
        payload. Raise it until pipe drops appear; that point is the answer.

config CHAIN_SYNTH_REALISTIC
    bool "Stage 0 pattern is REALISTIC (unset means CHECK)"
    default n
    help
        CHECK puts the raw LFSR state in every sample, so the host can prove
        every bit. REALISTIC is the smooth triangle-plus-noise signal the
        codec needs to show a plausible ratio. Default is CHECK because
        correctness has to be established before a ratio means anything.

config CHAIN_LINK_TEST_NO_WIFI
    bool "QSPI link test: no Wi-Fi, check each datagram on the node"
    default n
    help
        Never start the radio. Every datagram that arrives (over QSPI, or
        from the synthetic source) has its five frame headers checked here
        -- magic, type, channel count, payload length, seq running on --
        and is then dropped; a 1 Hz "link:" line reports the counts. Proves
        the FPGA -> ESP link before the node is admitted to the network,
        and keeps the radio's current off a shared ground while debugging.

config CHAIN_QSPI_PIN_SCAN
    bool "Find the QSPI wiring at boot (bench diagnostic)"
    default n
    help
        Before arming the receiver, try all 120 ways the five non-CS QSPI
        wires could be connected (SCLK, D0..D3) while the FPGA streams, and
        keep the one that delivers valid datagrams. The result is logged; if
        it differs from pins_s3.h the log says so, and the receiver runs on
        the wiring found (through the GPIO matrix, which is fine at 8 MHz but
        marginal at 24). Start the FPGA (MODE 4, run) before the ESP boots.
        Leave off for measurements: fix the wiring instead.

endmenu
```
